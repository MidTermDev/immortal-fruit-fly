// Host test for lib/flycore: replays fixtures generated by tools/gen_fixtures.py from sim/flysim.py (the reference model,
// itself differential-tested against FlyBrain.sol) and asserts every state field after every tick.
//   cd firmware && ../.venv/bin/pio test -e native -f test_core -v
#include <unity.h>
#include <stdio.h>
#include <string.h>
#include <time.h>
#include "flycore.h"
#include "keccak.h"
#include "../../fixtures/circuit_table.h"
#include "../../fixtures/params.h"
#include "../../fixtures/core_fixtures.h"

using namespace flycore;

static Circuit g_circuit;

void setUp() {}
void tearDown() {}

// ---------------------------------------------------------------- helpers

static void hex32(const uint8_t* h, char* out) {
  static const char* d = "0123456789abcdef";
  for (int i = 0; i < 32; ++i) { out[2 * i] = d[h[i] >> 4]; out[2 * i + 1] = d[h[i] & 15]; }
  out[64] = 0;
}

// Apply one fixture action; on a tick, assert every expected field.
static void apply_and_check(Core& core, const FixAction& a, int seq, int actionIndex) {
  char msg[200];
  if (a.op == FIX_STIMULATE) {
    snprintf(msg, sizeof msg, "seq %d action %d: stimulate(%u,%u,%u) rejected", seq, actionIndex, a.channel, a.param, a.strength);
    TEST_ASSERT_TRUE_MESSAGE(core.stimulate(a.channel, a.param, a.strength), msg);
    TEST_ASSERT_EQUAL_UINT64_MESSAGE(core.step + PARAMS_V2.stimTTL, core.stimUntil, "stimUntil = step + stimTTL");
    TEST_ASSERT_EQUAL_UINT8_MESSAGE(a.channel, core.stimChannel, "stimChannel");
    TEST_ASSERT_EQUAL_UINT8_MESSAGE(a.param, core.stimParam, "stimParam");
    TEST_ASSERT_EQUAL_UINT16_MESSAGE(a.strength, core.stimStrength, "stimStrength");
    return;
  }
  const bool stimWasActive = core.stimChannel != CH_NONE && core.step < core.stimUntil;
  const uint8_t chBefore = core.stimChannel;
  const uint64_t untilBefore = core.stimUntil;
  const FixExpect& e = FIX_EXPECT[a.tick];
  TickResult r = core.tick(a.steps);
  snprintf(msg, sizeof msg, "seq %d action %d tick(%u) -> step %llu", seq, actionIndex, a.steps, (unsigned long long)e.step);
  TEST_ASSERT_EQUAL_UINT16_MESSAGE(e.steps, r.steps, msg);
  TEST_ASSERT_EQUAL_UINT32_MESSAGE(e.spikes, r.spikes, msg);
  TEST_ASSERT_EQUAL_INT32_MESSAGE(e.headX, r.headX, msg);
  TEST_ASSERT_EQUAL_INT32_MESSAGE(e.headY, r.headY, msg);
  TEST_ASSERT_EQUAL_INT64_MESSAGE(e.posX, r.posX, msg);
  TEST_ASSERT_EQUAL_INT64_MESSAGE(e.posY, r.posY, msg);
  TEST_ASSERT_EQUAL_INT32_MESSAGE(e.headX, core.headX, msg);
  TEST_ASSERT_EQUAL_INT32_MESSAGE(e.headY, core.headY, msg);
  TEST_ASSERT_EQUAL_INT64_MESSAGE(e.posX, core.posX, msg);
  TEST_ASSERT_EQUAL_INT64_MESSAGE(e.posY, core.posY, msg);
  TEST_ASSERT_EQUAL_UINT64_MESSAGE(e.step, core.step, msg);
  TEST_ASSERT_EQUAL_UINT64_MESSAGE(e.totalSpikes, core.totalSpikes, msg);
  TEST_ASSERT_EQUAL_INT32_ARRAY_MESSAGE(&FIX_V[a.tick * FIX_N], core.v, FIX_N, msg);
  TEST_ASSERT_EQUAL_INT32_ARRAY_MESSAGE(&FIX_BIAS[a.tick * FIX_N], core.bias, FIX_N, msg);
  TEST_ASSERT_EQUAL_INT32_ARRAY_MESSAGE(&FIX_INP[a.tick * FIX_N], core.inp, FIX_N, msg);
  TEST_ASSERT_EQUAL_UINT16_ARRAY_MESSAGE(&FIX_HIST[a.tick * FIX_WEDGES], core.hist, FIX_WEDGES, msg);
  // the state hash, computed independently in Python from the same layout spec
  uint8_t h[32]; core.stateHash(h);
  char hx[65], ex[65]; hex32(h, hx); hex32(FIX_HASH[a.tick], ex);
  snprintf(msg, sizeof msg, "seq %d action %d stateHash %s != expected %s", seq, actionIndex, hx, ex);
  TEST_ASSERT_EQUAL_UINT8_ARRAY_MESSAGE(FIX_HASH[a.tick], h, 32, msg);
  // stimulus lifetime: active while step < stimUntil, cleared at the end of the tick that passes it
  if (stimWasActive) {
    if (core.step >= untilBefore) TEST_ASSERT_EQUAL_UINT8_MESSAGE(CH_NONE, core.stimChannel, "stimulus must clear once step >= stimUntil");
    else TEST_ASSERT_EQUAL_UINT8_MESSAGE(chBefore, core.stimChannel, "stimulus must persist while step < stimUntil");
  } else {
    TEST_ASSERT_EQUAL_UINT8_MESSAGE(chBefore, core.stimChannel, "an inactive stimulus is left as is");
  }
  // display side-channels agree with the result
  uint32_t sumSpk = 0, sumBins = 0;
  for (int i = 0; i < FIX_N; ++i) sumSpk += core.lastSpk[i];
  for (int w = 0; w < FIX_WEDGES; ++w) sumBins += core.lastBins[w];
  TEST_ASSERT_EQUAL_UINT32_MESSAGE(e.spikes, sumSpk, "lastSpk sums to the tick's spikes");
  TEST_ASSERT_TRUE_MESSAGE(sumBins <= e.spikes, "lastBins are a subset of the spikes");
}

// ------------------------------------------------------------------ tests

void test_circuit_table_loads_and_matches_hash() {
  TEST_ASSERT_TRUE(g_circuit.load(CIRCUIT_TABLE, CIRCUIT_TABLE_LEN));
  TEST_ASSERT_EQUAL_INT(FIX_N, g_circuit.N);
  TEST_ASSERT_EQUAL_INT(6522, g_circuit.S);
  TEST_ASSERT_EQUAL_UINT16(0, g_circuit.offset(0));
  TEST_ASSERT_EQUAL_UINT16(6522, g_circuit.offset(g_circuit.N));
  // contracts/data/circuit_meta.json table_keccak256
  static const uint8_t expected[32] = {0xff, 0xbe, 0x0e, 0x7f, 0x28, 0xe1, 0xf0, 0xdd, 0x2c, 0xfa, 0xa0, 0x1d, 0x1d, 0x22, 0x1c, 0x50,
                                       0x2b, 0xf4, 0x1c, 0x1f, 0xd5, 0x19, 0xeb, 0xfe, 0x8d, 0x9b, 0x82, 0x03, 0xe7, 0xce, 0xdf, 0xc2};
  uint8_t h[32]; keccak256(CIRCUIT_TABLE, CIRCUIT_TABLE_LEN, h);
  TEST_ASSERT_EQUAL_UINT8_ARRAY(expected, h, 32);
  // cell-type census as in circuit_meta / flysim: 47 EPG, 4 EPGt, 20 PEG, 20 PEN_a, 22 PEN_b, 42 Δ7
  int census[6] = {0, 0, 0, 0, 0, 0};
  for (int i = 0; i < g_circuit.N; ++i) census[g_circuit.type[i]]++;
  TEST_ASSERT_EQUAL_INT(47, census[T_EPG]);
  TEST_ASSERT_EQUAL_INT(4, census[T_EPGT]);
  TEST_ASSERT_EQUAL_INT(20, census[T_PEG]);
  TEST_ASSERT_EQUAL_INT(20, census[T_PEN_A]);
  TEST_ASSERT_EQUAL_INT(22, census[T_PEN_B]);
  TEST_ASSERT_EQUAL_INT(42, census[T_DELTA7]);
}

void test_circuit_rejects_bad_tables() {
  static uint8_t bad[CIRCUIT_TABLE_LEN];
  Circuit c;
  TEST_ASSERT_FALSE(c.load(CIRCUIT_TABLE, 3));                      // short
  TEST_ASSERT_FALSE(c.load(CIRCUIT_TABLE, CIRCUIT_TABLE_LEN - 1));  // length
  memcpy(bad, CIRCUIT_TABLE, CIRCUIT_TABLE_LEN); bad[0] = 2;
  TEST_ASSERT_FALSE(c.load(bad, CIRCUIT_TABLE_LEN));                // version
  memcpy(bad, CIRCUIT_TABLE, CIRCUIT_TABLE_LEN); bad[4] = 6;
  TEST_ASSERT_FALSE(c.load(bad, CIRCUIT_TABLE_LEN));                // type
  memcpy(bad, CIRCUIT_TABLE, CIRCUIT_TABLE_LEN); bad[4 + FIX_N] = 16;
  TEST_ASSERT_FALSE(c.load(bad, CIRCUIT_TABLE_LEN));                // wedge
  memcpy(bad, CIRCUIT_TABLE, CIRCUIT_TABLE_LEN); bad[4 + 3 * FIX_N + 1] = 1;
  TEST_ASSERT_FALSE(c.load(bad, CIRCUIT_TABLE_LEN));                // offset0
  memcpy(bad, CIRCUIT_TABLE, CIRCUIT_TABLE_LEN); bad[4 + 3 * FIX_N + 2 * (FIX_N + 1)] = 0xFF;
  TEST_ASSERT_FALSE(c.load(bad, CIRCUIT_TABLE_LEN));                // post >= N
  TEST_ASSERT_TRUE(c.load(CIRCUIT_TABLE, CIRCUIT_TABLE_LEN));       // and the real one still loads
}

void test_isqrt_matches_contract_sqrt() {
  TEST_ASSERT_EQUAL_UINT64(0, isqrt(0));
  TEST_ASSERT_EQUAL_UINT64(1, isqrt(1));
  TEST_ASSERT_EQUAL_UINT64(1, isqrt(3));
  TEST_ASSERT_EQUAL_UINT64(2, isqrt(4));
  TEST_ASSERT_EQUAL_UINT64(2, isqrt(8));
  TEST_ASSERT_EQUAL_UINT64(3, isqrt(9));
  TEST_ASSERT_EQUAL_UINT64(99, isqrt(9999));
  TEST_ASSERT_EQUAL_UINT64(100, isqrt(10000));
  TEST_ASSERT_EQUAL_UINT64(65535, isqrt(0xFFFFFFFFull));
  TEST_ASSERT_EQUAL_UINT64(65536, isqrt(0x100000000ull));
  TEST_ASSERT_EQUAL_UINT64(3037000499ull, isqrt(0x7FFFFFFFFFFFFFFFull));
  for (uint64_t r = 1; r < 3000; r += 7) {  // floor sqrt around every perfect square
    TEST_ASSERT_EQUAL_UINT64(r, isqrt(r * r));
    TEST_ASSERT_EQUAL_UINT64(r - 1, isqrt(r * r - 1));
    TEST_ASSERT_EQUAL_UINT64(r, isqrt(r * r + 1));
  }
}

void test_genesis_state_hash() {
  Core core(g_circuit, PARAMS_V2);
  uint8_t h[32]; core.stateHash(h);
  TEST_ASSERT_EQUAL_UINT8_ARRAY(FIX_GENESIS_HASH, h, 32);
}

void test_stimulate_rejects_bad_args() {
  Core core(g_circuit, PARAMS_V2);
  TEST_ASSERT_FALSE(core.stimulate(CH_NONE, 0, 1));
  TEST_ASSERT_FALSE(core.stimulate(5, 0, 1));
  TEST_ASSERT_FALSE(core.stimulate(CH_CUE, 0, 0));
  TEST_ASSERT_FALSE(core.stimulate(CH_CUE, 16, 1));
  TEST_ASSERT_EQUAL_UINT8(CH_NONE, core.stimChannel);
  TEST_ASSERT_TRUE(core.stimulate(CH_CUE, 15, 255));
  TEST_ASSERT_TRUE(core.stimulate(CH_SHOCK, 200, 1));  // param is free for non-cue channels, as on-chain
  TEST_ASSERT_EQUAL_UINT64(PARAMS_V2.stimTTL, core.stimUntil);
}

void test_tick_rejects_bad_steps() {
  Core core(g_circuit, PARAMS_V2);
  core.tick(8);
  uint8_t before[32]; core.stateHash(before);
  const uint64_t step = core.step;
  TickResult r = core.tick(0);
  TEST_ASSERT_EQUAL_UINT16(0, r.steps);
  r = core.tick(PARAMS_V2.maxSteps + 1);
  TEST_ASSERT_EQUAL_UINT16(0, r.steps);
  uint8_t after[32]; core.stateHash(after);
  TEST_ASSERT_EQUAL_UINT8_ARRAY(before, after, 32);
  TEST_ASSERT_EQUAL_UINT64(step, core.step);
  r = core.tick(PARAMS_V2.maxSteps);
  TEST_ASSERT_EQUAL_UINT16(PARAMS_V2.maxSteps, r.steps);
}

// Every fixture sequence, every tick, every field.
static void replay_sequence(int seq) {
  Core core(g_circuit, PARAMS_V2);
  int ticks = 0;
  for (int k = FIX_SEQ_START[seq]; k < FIX_SEQ_START[seq + 1]; ++k) {
    apply_and_check(core, FIX_ACTIONS[k], seq, k - FIX_SEQ_START[seq]);
    if (FIX_ACTIONS[k].op == FIX_TICK) ++ticks;
  }
  TEST_ASSERT_EQUAL_INT_MESSAGE(10, ticks, "each fixture sequence has 10 ticks");
}
void test_replay_sequence_0() { replay_sequence(0); }
void test_replay_sequence_1() { replay_sequence(1); }
void test_replay_sequence_2() { replay_sequence(2); }
void test_replay_sequence_3() { replay_sequence(3); }
void test_replay_sequence_4() { replay_sequence(4); }
void test_replay_sequence_5() { replay_sequence(5); }

void test_all_fixture_ticks_covered() {
  int ticks = 0;
  for (int k = 0; k < FIX_SEQ_START[FIX_SEQUENCES]; ++k) if (FIX_ACTIONS[k].op == FIX_TICK) ++ticks;
  TEST_ASSERT_EQUAL_INT(FIX_TICKS, ticks);
  TEST_ASSERT_EQUAL_INT(60, FIX_TICKS);
}

// setState (the chain sync path) reproduces the state exactly and continues identically.
void test_set_state_round_trip() {
  Core a(g_circuit, PARAMS_V2);
  for (int k = FIX_SEQ_START[0]; k < FIX_SEQ_START[1]; ++k) {
    const FixAction& act = FIX_ACTIONS[k];
    if (act.op == FIX_STIMULATE) a.stimulate(act.channel, act.param, act.strength); else a.tick(act.steps);
  }
  // fresh stimulus so the sync carries an active one
  TEST_ASSERT_TRUE(a.stimulate(CH_CUE, 5, 3));
  int16_t v16[Core::MAX_N];
  int8_t b8[Core::MAX_N];
  for (int i = 0; i < FIX_N; ++i) {
    TEST_ASSERT_TRUE_MESSAGE(a.v[i] >= -32768 && a.v[i] <= 32767, "v fits int16 as on-chain");
    TEST_ASSERT_TRUE_MESSAGE(a.bias[i] >= -128 && a.bias[i] <= 127, "bias fits int8 as on-chain");
    v16[i] = (int16_t)a.v[i]; b8[i] = (int8_t)a.bias[i];
  }
  Core b(g_circuit, PARAMS_V2);
  b.setState(v16, b8, a.hist, a.inp, a.step, a.headX, a.headY, a.posX, a.posY, a.stimChannel, a.stimParam, a.stimStrength, a.stimUntil);
  b.totalSpikes = a.totalSpikes;
  uint8_t ha[32], hb[32]; a.stateHash(ha); b.stateHash(hb);
  TEST_ASSERT_EQUAL_UINT8_ARRAY(ha, hb, 32);
  for (int k = 0; k < 6; ++k) {
    TickResult ra = a.tick(16), rb = b.tick(16);
    TEST_ASSERT_EQUAL_UINT32(ra.spikes, rb.spikes);
    TEST_ASSERT_EQUAL_INT32(ra.headX, rb.headX);
    TEST_ASSERT_EQUAL_INT64(ra.posX, rb.posX);
    a.stateHash(ha); b.stateHash(hb);
    TEST_ASSERT_EQUAL_UINT8_ARRAY(ha, hb, 32);
    TEST_ASSERT_EQUAL_UINT8(a.stimChannel, b.stimChannel);
  }
  TEST_ASSERT_EQUAL_UINT8(CH_NONE, a.stimChannel);  // 96 steps > stimTTL 64: the cue expired on both
}

// Two cores fed the same actions are identical; a different stimulus changes the state (the fixtures do exercise it).
void test_determinism() {
  Core a(g_circuit, PARAMS_V2), b(g_circuit, PARAMS_V2), c(g_circuit, PARAMS_V2);
  a.stimulate(CH_CUE, 4, 4); b.stimulate(CH_CUE, 4, 4); c.stimulate(CH_CUE, 12, 4);
  for (int k = 0; k < 4; ++k) { a.tick(32); b.tick(32); c.tick(32); }
  uint8_t ha[32], hb[32], hc[32]; a.stateHash(ha); b.stateHash(hb); c.stateHash(hc);
  TEST_ASSERT_EQUAL_UINT8_ARRAY(ha, hb, 32);
  TEST_ASSERT_FALSE(memcmp(ha, hc, 32) == 0);
}

void test_throughput_1000_steps() {
  Core core(g_circuit, PARAMS_V2);
  core.stimulate(CH_CUE, 4, 4);
  const int STEPS = 1000, PER_TICK = 50;  // 20 ticks of 50 steps = 1000 steps
  uint64_t spikes = 0;
  clock_t t0 = clock();
  for (int k = 0; k < STEPS / PER_TICK; ++k) spikes += core.tick(PER_TICK).spikes;
  clock_t t1 = clock();
  double secs = (double)(t1 - t0) / CLOCKS_PER_SEC;
  TEST_ASSERT_EQUAL_UINT64(STEPS, core.step);
  printf("\n[flycore] %d steps (N=%d) in %.3f s: %.0f steps/s, %.1f us/step, %llu spikes\n", STEPS, g_circuit.N, secs,
         secs > 0 ? STEPS / secs : 0.0, secs > 0 ? secs * 1e6 / STEPS : 0.0, (unsigned long long)spikes);
  fflush(stdout);
  TEST_ASSERT_TRUE(spikes > 0);
}

int main(int, char**) {
  UNITY_BEGIN();
  RUN_TEST(test_circuit_table_loads_and_matches_hash);
  RUN_TEST(test_circuit_rejects_bad_tables);
  RUN_TEST(test_isqrt_matches_contract_sqrt);
  RUN_TEST(test_genesis_state_hash);
  RUN_TEST(test_stimulate_rejects_bad_args);
  RUN_TEST(test_tick_rejects_bad_steps);
  RUN_TEST(test_all_fixture_ticks_covered);
  RUN_TEST(test_replay_sequence_0);
  RUN_TEST(test_replay_sequence_1);
  RUN_TEST(test_replay_sequence_2);
  RUN_TEST(test_replay_sequence_3);
  RUN_TEST(test_replay_sequence_4);
  RUN_TEST(test_replay_sequence_5);
  RUN_TEST(test_set_state_round_trip);
  RUN_TEST(test_determinism);
  RUN_TEST(test_throughput_1000_steps);
  return UNITY_END();
}
